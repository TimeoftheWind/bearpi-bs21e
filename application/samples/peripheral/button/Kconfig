## application/samples/peripheral/button/Kconfig
```kconfig
#===============================================================================
# @brief    Kconfig file.
# Copyright (c) HiSilicon (Shanghai) Technologies Co., Ltd. 2023-2023. All rights reserved.
#===============================================================================

config BUTTON_PIN
    int
    prompt "Choose BLINKY_PIN pin."
    depends on SAMPLE_SUPPORT_BUTTON
    default 2
```
