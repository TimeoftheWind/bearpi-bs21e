## application/samples/products/sle_measure_dis/Kconfig
```kconfig
#===============================================================================
# @brief    Kconfig file.
# Copyright (c) HiSilicon (Shanghai) Technologies Co., Ltd. 2024-2024. All rights reserved.
#===============================================================================

choice
    prompt "Select sle uart type"
    default SAMPLE_SUPPORT_SLE_MEASURE_DIS_SERVER
    config SAMPLE_SUPPORT_SLE_MEASURE_DIS_SERVER
        bool "Enable SLE MEASURE_DIS Server sample."
    config SAMPLE_SUPPORT_SLE_MEASURE_DIS_CLIENT
        bool "Enable SLE MEASURE_DIS Client sample."
endchoice

if SAMPLE_SUPPORT_SLE_MEASURE_DIS_SERVER
config SAMPLE_MEASURE_ANCHOR_SUFFIX
    int "Server address suffix (5 receives IMU; others range only)"
    range 5 9
    default 5
endif
```
